// Copyright 2022 Manna Harbour
// https://github.com/manna-harbour/miryoku

#include "../miryoku/custom_config.h"
#include "../miryoku/mapping/36/minidox.h"
#include "../miryoku/miryoku.dtsi"

&mouse_ps2_input_listener {
  xy-swap;
  x-invert;
  y-invert;

  // Set the layer that should automatically activate when the mouse is
  // moving.
  layer-toggle = <U_MOUSE>;

  // How long the mouse needs to move for before the layer is activated (to
  // avoid accidental activations while typing) (Default: 250)
  layer-toggle-delay-ms = <250>;

  // How long to wait, after the last mouse movement, before deactivating
  // the layer (Default: 250)
  layer-toggle-timeout-ms = <250>;
};